## package/libimxdmabuffer/Config.in
```kconfig
config BR2_PACKAGE_LIBIMXDMABUFFER
	bool "libimxdmabuffer"
	depends on BR2_aarch64 # Only relevant for i.MX8M
	select BR2_PACKAGE_LINUX_IMX_HEADERS
	help
	  This library provides an API for allocating memory blocks that
	  are physically contiguous on i.MX platforms.

	  https://github.com/Freescale/libimxdmabuffer
```

## package/libimxvpuapi-v2/Config.in
```kconfig
comment "libimxvpuapi-v2 needs an i.MX8 platform with VPU support"
	depends on BR2_aarch64
	depends on !BR2_PACKAGE_FREESCALE_IMX_HAS_VPU_HANTRO

config BR2_PACKAGE_LIBIMXVPUAPI_V2
	bool "libimxvpuapi-v2"
	depends on BR2_aarch64 # Only relevant for i.MX8
	depends on BR2_PACKAGE_FREESCALE_IMX_HAS_VPU_HANTRO
	select BR2_PACKAGE_LIBIMXDMABUFFER
	select BR2_PACKAGE_IMX_VPU_HANTRO
	help
	  This library provides an API for using the for the i.MX8M VPU hardware
	  video engines.

	  https://github.com/Freescale/libimxvpuapi/tree/v2
```

## package/linux-imx-headers/Config.in
```kconfig
config BR2_PACKAGE_LINUX_IMX_HEADERS
	bool "linux-imx-headers"
	depends on BR2_aarch64 # Only relevant for i.MX8M
	help
	  This installs the i.MX headers in staging area. This is the
	  equivalent to the following Yocto recipe:
	  https://github.com/Freescale/meta-freescale/blob/dunfell/recipes-kernel/linux/linux-imx-headers_5.4.3.bb
```

## package/qca-firmware/Config.in
```kconfig
menuconfig BR2_PACKAGE_QCA_FIRMWARE
	bool "qca-firmware"
	help
	  This modules adds firmware files for the Qualcomm-based
	  Wi-Fi/BT modules such as the BD-SDMAC.

if BR2_PACKAGE_QCA_FIRMWARE
choice
	prompt "WiFi/BT module"

config BR2_PACKAGE_QCA_FIRMWARE_QCA9377_BDSDMAC
	bool "qca9377-sdio (BD-SDMAC)"

config BR2_PACKAGE_QCA_FIRMWARE_QCA6174_PCIE
	bool "qca6174-pci"
endchoice
endif
```

## package/qcacld-module/Config.in
```kconfig
comment "qcacld-module needs a Linux kernel to be built"
	depends on !BR2_LINUX_KERNEL

menuconfig BR2_PACKAGE_QCACLD_MODULE
	bool "qcacld-2.0 kernel module"
	depends on BR2_LINUX_KERNEL
	help
	  This kernel module adds support for the Qualcomm-based
	  Wi-Fi modules using qcacld-2.0 such as the BD-SDMAC.

if BR2_PACKAGE_QCACLD_MODULE
choice
	prompt "Module interface"

config BR2_PACKAGE_QCACLD_MODULE_IF_SDIO
	bool "sdio"

config BR2_PACKAGE_QCACLD_MODULE_IF_PCI
	bool "pci"
endchoice

config BR2_PACKAGE_QCACLD_MODULE_IF
	string
	default "sdio" if BR2_PACKAGE_QCACLD_MODULE_IF_SDIO
	default "pci" if BR2_PACKAGE_QCACLD_MODULE_IF_PCI
endif
```
